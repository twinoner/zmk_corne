/*
 * Copyright (c) 2022 The ZMK Contributors
 * boards/shields/nice_view_gem/nice_view_gem.overlay
 *
 * SPDX-License-Identifier: MIT
 */

&nice_view_spi {
    status = "okay";
    nice_view: ls0xx@0 {
        compatible = "sharp,ls0xx";
        spi-max-frequency = <1000000>;
        reg = <0>;
        width = <160>;
        height = <68>;
        label = "LS0XX";
    };
};

/ {
    chosen {
        zephyr,display = &nice_view;
    };
};
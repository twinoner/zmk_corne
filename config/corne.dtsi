/*
*
* Copyright (c) 2024 The ZMK Contributors
* SPDX-License-Identifier: MIT
*
*/
#include <dt-bindings/led/led.h>

/ {
    chosen {
        zmk,backlight = &backlight;
    };

    backlight: backlight {
        compatible = "zmk,backlight";
    };
};
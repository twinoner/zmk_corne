## Kconfig
```kconfig
# SPDX-License-Identifier: MIT

rsource "drivers/Kconfig"
rsource "src/pointing/Kconfig"
```

## config/west.yml
```yaml
manifest:
  remotes:
    # zmk official
    - name: zmkfirmware
      url-base: https://github.com/zmkfirmware
      # nice-view-gem
    - name: m165437
      url-base: https://github.com/M165437
  projects:
    - name: zmk
      remote: zmkfirmware
      revision: v0.3.0
      import: app/west.yml
    - name: nice-view-gem
      remote: m165437
      revision: v0.3.0

  self:
    path: config
```

## drivers/input/Kconfig
```kconfig
# SPDX-License-Identifier: MIT

if INPUT

config INPUT_PIM447
    bool "Pimoroni PIM447 trackball"
    default y
    depends on I2C
    depends on DT_HAS_PIMORONI_PIM447_ENABLED
    help
      I2C-polled input driver for the Pimoroni PIM447 trackball.
      Reports INPUT_REL_X / INPUT_REL_Y and INPUT_BTN_0.

endif # INPUT
```

## dts/bindings/behaviors/zmk,behavior-click-lock.yaml
```yaml
# SPDX-License-Identifier: MIT

description: |
  Toggles click lock on the trackball button between momentary (the default)
  and lock, where the first click latches the button down and the second
  releases it.

  Engaging a lock and then turning the mode off does not release the button
  from here; the next trackball press does.

compatible: "zmk,behavior-click-lock"

include: zero_param.yaml
```

## dts/bindings/input/pimoroni,pim447.yaml
```yaml
# SPDX-License-Identifier: MIT

description: Pimoroni PIM447 trackball

compatible: "pimoroni,pim447"

include: [i2c-device.yaml]

properties:
  poll-interval:
    type: int
    default: 50
    description: |
      Interval in milliseconds at which the trackball registers are polled.
```

## dts/bindings/input_processors/zmk,input-processor-accel.yaml
```yaml
# SPDX-License-Identifier: MIT

description: |
  Velocity-dependent acceleration for relative pointing devices.

  All tuning is per axis. Every default reproduces the ds87 fork's feel
  exactly, so overriding nothing is the known-good baseline.

  Smoothing state is kept per node, not per listener: referencing one instance
  from two input listeners makes them share state.

compatible: "zmk,input-processor-accel"

include: ip_zero_param.yaml

properties:
  type:
    type: int
    required: true
    description: Event type to process, e.g. INPUT_EV_REL.

  x-code:
    type: int
    required: true
    description: Event code treated as the X axis, e.g. INPUT_REL_X.

  y-code:
    type: int
    required: true
    description: Event code treated as the Y axis, e.g. INPUT_REL_Y.

  max-accel-x:
    type: int
    default: 100
    description: |
      Percentage scaling of the gain curve on X. 100 leaves the curve as-is.
      Capped at 2255 by a BUILD_ASSERT, above which the curve saturates the
      int16 event value.

  max-accel-y:
    type: int
    default: 100
    description: Percentage scaling of the gain curve on Y. See max-accel-x.

  move-inertia-x:
    type: int
    default: 78
    description: |
      Weight given to history by the exponential moving average on X, 0-99.
      0 disables smoothing. 78 matches the 8-sample boxcar the fork used.

  move-inertia-y:
    type: int
    default: 78
    description: EMA weight given to history on Y, 0-99. See move-inertia-x.

  exactness-x:
    type: int
    default: 0
    description: |
      Absolute X values at or below this bypass the acceleration curve and
      pass through unscaled, buying back fine control that the curve's 3x
      floor otherwise denies. They are still smoothed by move-inertia-x and
      subject to fraction carry, so they are not exempt from the pipeline.

  exactness-y:
    type: int
    default: 0
    description: |
      Absolute Y values at or below this bypass the acceleration curve and
      pass through unscaled. See exactness-x; still smoothed by
      move-inertia-y.

  accel-curve:
    type: array
    description: |
      Optional gain curve override, shared by both axes and indexed by the
      absolute event value. Must have exactly 30 entries and index 0 must be
      0; both are enforced by BUILD_ASSERT. Omit to use the built-in table.
```

## dts/bindings/input_processors/zmk,input-processor-click-lock.yaml
```yaml
# SPDX-License-Identifier: MIT

description: |
  Turns a pointing device button into a lock: the first click latches it down
  and the second releases it. Off at boot; the &click_lock behavior turns it on
  and off from the keymap.

  Lock state is global, not per node, so referencing one instance from several
  listener chains is the supported way to keep the lock working across layer
  overrides — a layer override replaces the base chain rather than extending
  it, and a click made on a layer whose chain omits this processor would
  otherwise bypass the lock.

compatible: "zmk,input-processor-click-lock"

include: ip_zero_param.yaml

properties:
  type:
    type: int
    required: true
    description: Event type to process, e.g. INPUT_EV_KEY.

  code:
    type: int
    required: true
    description: Event code of the button to lock, e.g. INPUT_BTN_0.
```

## src/pointing/Kconfig
```kconfig
# SPDX-License-Identifier: MIT

if ZMK_POINTING

config ZMK_INPUT_PROCESSOR_ACCEL
    bool "Trackball acceleration input processor"
    default y
    depends on DT_HAS_ZMK_INPUT_PROCESSOR_ACCEL_ENABLED
    help
      Velocity-dependent acceleration with per-axis smoothing for relative
      pointing devices. Restores the gain curve and averaging the ds87 fork
      applied before the ZMK v0.3.0 migration.

config ZMK_INPUT_PROCESSOR_ACCEL_MAX_DEVICES
    int "Input devices tracked per accel processor instance"
    default 4
    depends on ZMK_INPUT_PROCESSOR_ACCEL
    help
      Smoothing state is kept per input device index. Events from a device at
      or above this index pass through unaccelerated.

config ZMK_CLICK_LOCK
    bool "Trackball click lock"
    default y
    depends on DT_HAS_ZMK_INPUT_PROCESSOR_CLICK_LOCK_ENABLED || DT_HAS_ZMK_BEHAVIOR_CLICK_LOCK_ENABLED
    help
      Lets the trackball button latch: first click locks it down, second click
      releases it. Covers both the zip_click_lock input processor and the
      &click_lock behavior that toggles the mode, because the two share one
      mode flag and compiling only one of them would not link.

endif # ZMK_POINTING
```
